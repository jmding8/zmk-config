## config/boards/shields/mercury-k/Kconfig.defconfig
```kconfig
if SHIELD_MERCURY-K_LEFT

config ZMK_KEYBOARD_NAME
	default "Mercury-K"

config ZMK_SPLIT_BLE_ROLE_CENTRAL
	default y

endif

if SHIELD_MERCURY-K_LEFT || SHIELD_MERCURY-K_RIGHT

config ZMK_SPLIT
	default y

endif
```

## config/boards/shields/mercury-k/Kconfig.shield
```kconfig
config SHIELD_MERCURY-K_LEFT
	def_bool $(shields_list_contains,mercury-k_left)

config SHIELD_MERCURY-K_RIGHT
	def_bool $(shields_list_contains,mercury-k_right)
```
